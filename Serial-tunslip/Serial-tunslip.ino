byte send[] = {0x60, 0x00, 0x00, 0x00, 0x00, 0x13, 0x11, 0x40, 0xaa, 0xaa, 0x00, 0x00, 0x00,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 0x02, 0xc0};

void setup() {
    Serial.begin(115200);
    Serial1.begin(115200);
    while (!Serial) {
    }

    Serial.println("Hello!");
    Serial1.println("Hello!");

}

void receivePacket() {
    byte receive = Serial1.read();
    Serial.print("0x");
    if (receive < 0x10) {
        Serial.print("0");
    }
    Serial.print(receive, HEX);
    Serial.print(" ");
}

void loop() {
    if (Serial1.available()) {
        Serial.println("Receive Packet:");
        while (1) {
            if (!Serial1.available()) {
                break;
            }
            receivePacket();
        };
        Serial.println();
    }

    delay(5000);
    Serial.println("Send data");
    for (int i = 0; i <= 59; i++) {
        Serial1.write(send[i]);
    }
}








